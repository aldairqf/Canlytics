VERSION ""

NS_ :

BS_:

BU_:

BO_ 2566841088 TestBamMessage: 34 Vector__XXX
 SG_ TestValue1 : 0|16@1+ (1,0) [0|0] "" Vector__XXX

BO_ 2565866496 TestNormalMessage: 8 Vector__XXX
 SG_ TestValue2 : 0|8@1+ (1,0) [0|0] "" Vector__XXX
